## arch/arm/mach-msm/cust/Kconfig
```kconfig
if CUST_PANTECH_H

#
# PANTECH Cust feature section
#

if MACH_MSM8X55_MINI
config DEFINE_LIST_MINI
	bool
	default y
	select PANTECH_SDCARD
	select PANTECH_CAMREA
	select PANTECH_PMIC8058
	select PANTECH_BT
	select PANTECH_MTP
	select PANTECH_AUDIO_FAB2200
	select PANTECH_AUDIO_RX_VOLUME
	select PANTECH_AUDIO_SUBCHIP_CAL_TOOL
	select PANTECH_ASR_PATH
	select PANTECH_USB
	select PANTECH_UMS_ONLY
	select PANTECH_WIFI_MAC_ADDR
	select PANTECH_WIFI_RAND_MAC
	select PANTECH_WIFI_MMC
	select PANTECH_ERR_CRASH_LOGGING
    select PANTECH_DEBUG
	select PANTECH_MINI_BT_GROUPING
    select PANTECH_MINI_AUDIO_AUDIENCE1028
#    select PANTECH_MINI_HDRADIO 
endif

if MACH_MSM8X55_J_MASAI_E
config DEFINE_LIST_J_MASAI_E
	bool
	default y
	select PANTECH_SDCARD
	select PANTECH_CAMREA
	select PANTECH_PMIC8058
	select PANTECH_BT
	select PANTECH_MTP
	select PANTECH_USB
	select PANTECH_WIFI_MAC_ADDR
	select PANTECH_WIFI_RAND_MAC
	select PANTECH_WIFI_MMC
	select PANTECH_UMS_ONLY
	select PANTECH_AUDIO_FAB2200
	select PANTECH_AUDIO_RX_VOLUME
	select PANTECH_AUDIO_SUBCHIP_CAL_TOOL
	select PANTECH_ASR_PATH
	select PANTECH_ERR_CRASH_LOGGING
    select PANTECH_DEBUG
	select PANTECH_MASAI_E_SEPERATE_CALL_MEDIA_PATH
	
	select PANTECH_AUDIO_FAB2200_SEPARATE_HPVOLUME_CTRL
	select PANTECH_MIRACHJ_RXMUTE
	select PANTECH_TEST_CODE_PATH

endif

if MACH_MSM8X55_LASER2
config DEFINE_LIST_LASER2
	bool
	default y
	select PANTECH_SDCARD
	select PANTECH_CAMREA
	select PANTECH_PMIC8058
	select PANTECH_BT
	select PANTECH_MTP
	select PANTECH_AUDIO_FAB2200
	select PANTECH_AUDIO_RX_VOLUME
	select PANTECH_AUDIO_SUBCHIP_CAL_TOOL
	select PANTECH_ASR_PATH
	select PANTECH_USB
	select PANTECH_UMS_ONLY
	select PANTECH_WIFI_MAC_ADDR
	select PANTECH_WIFI_RAND_MAC
	select PANTECH_WIFI_MMC
	select PANTECH_ERR_CRASH_LOGGING
    	select PANTECH_DEBUG
	select PANTECH_MINI_BT_GROUPING
	select PANTECH_LASER2_AUDIENCE2020
endif

config PANTECH_SDCARD
	bool

config PANTECH_CAMERA
	bool
 
config PANTECH_PMIC8058
	bool

config PANTECH_BT
	bool

config PANTECH_MTP
	bool

config PANTECH_MINI_AUDIO_AUDIENCE1028
	bool

config PANTECH_LASER2_AUDIENCE2020
	bool

config PANTECH_USB
	bool

config PANTECH_UMS_ONLY
	bool
	
config PANTECH_WIFI_MAC_ADDR
	bool

config PANTECH_WIFI_RAND_MAC
	bool

config PANTECH_WIFI_MMC
	bool

config PANTECH_ERR_CRASH_LOGGING
      bool

config PANTECH_AUDIO_FAB2200
	bool

config PANTECH_AUDIO_SUBCHIP_CAL_TOOL
	bool

config PANTECH_AUDIO_RX_VOLUME
	bool

config PANTECH_ASR_PATH
	bool

config PANTECH_MASAI_E_SEPERATE_CALL_MEDIA_PATH
	bool

config PANTECH_AUDIO_FAB2200_SEPARATE_HPVOLUME_CTRL
	bool

config PANTECH_MIRACHJ_RXMUTE
	bool
	
config PANTECH_MINI_BT_GROUPING
	bool

config PANTECH_TEST_CODE_PATH
	bool

# config PANTECH_MINI_HDRADIO
#	bool

config PANTECH_DEBUG
    bool
	
endif
```

## drivers/input/sensor/Kconfig
```kconfig
source "drivers/input/sensor/accelerometer/Kconfig"
source "drivers/input/sensor/geomagnetic/Kconfig"
source "drivers/input/sensor/orientation/Kconfig"
source "drivers/input/sensor/proximity/Kconfig"
```
